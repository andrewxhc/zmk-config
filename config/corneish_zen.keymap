/* activate bluetooth */
#define CONFIG_WIRELESS

#define ZMK_BASE_LAYER(name, LT, RT, LM, RM, LB, RB, LH, RH)                   \
    ZMK_LAYER(                                                                 \
        name,                                                                  \
        LT RT                                                                  \
        LM RM                                                                  \
        LB RB                                                                  \
        LH RH                                                                  \
    )

/* source key position labels for the 6-column layout */
#include "zmk-helpers/key-labels/42.h"

/* source the main keymap */
#include "base.keymap"

/* use 6-column layout for Zen */
/{ chosen { zmk,physical-layout = &foostan_corne_6col_layout; }; };
